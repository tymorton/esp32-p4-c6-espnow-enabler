## components/esp_now_hosted_host/Kconfig
```kconfig
menu "ESP-NOW over esp_hosted (host)"

    config ESP_NOW_HOSTED_HOST_TIMEOUT_MS
        int "Request timeout (ms)"
        range 50 10000
        default 2000
        help
            Max wait for the co-processor's reply to one esp_now_* call. Normal round trip
            is ~1 ms; the margin covers Wi-Fi/BLE contention on the co-processor.

    config ESP_NOW_HOSTED_HOST_QUEUE_LEN
        int "Receive/send-status event queue length"
        range 4 128
        default 16
        help
            Events beyond this are dropped and counted (esp_now_hosted_host_get_stats).

    config ESP_NOW_HOSTED_HOST_TASK_STACK
        int "Callback dispatch task stack (bytes)"
        default 4096

    config ESP_NOW_HOSTED_HOST_TASK_PRIO
        int "Callback dispatch task priority"
        range 1 24
        default 10

    config ESP_NOW_HOSTED_HOST_TASK_CORE
        int "Callback dispatch task core (-1 = any)"
        range -1 1
        default -1

endmenu
```

## examples/ping_pong/sdkconfig.defaults
```kconfig
CONFIG_IDF_TARGET="esp32p4"

# ESP-Hosted SDIO Interface Configuration
CONFIG_ESP_HOSTED_ENABLED=y
CONFIG_ESP_HOSTED_SDIO_HOST_INTERFACE=y
CONFIG_ESP_HOSTED_CP_TARGET_ESP32C6=y
CONFIG_ESP_HOSTED_SDIO_CLOCK_FREQ_KHZ=10000
CONFIG_ESP_HOSTED_SDIO_BUS_WIDTH=4
CONFIG_ESP_HOSTED_SDIO_SLOT=1

# Waveshare ESP32-P4 Standard Pinout
CONFIG_ESP_HOSTED_SDIO_PIN_CLK=18
CONFIG_ESP_HOSTED_SDIO_PIN_CMD=19
CONFIG_ESP_HOSTED_SDIO_PIN_D0=14
CONFIG_ESP_HOSTED_SDIO_PIN_D1=15
CONFIG_ESP_HOSTED_SDIO_PIN_D2=16
CONFIG_ESP_HOSTED_SDIO_PIN_D3=17
CONFIG_ESP_HOSTED_GPIO_SLAVE_RESET_SLAVE=54

# CustomRpc for ESP-NOW packet forwarding
CONFIG_ESP_HOSTED_ENABLE_PEER_DATA_TRANSFER=y
```
